## CMakeLists.txt
```
# SPDX-License-Identifier: Apache-2.0

cmake_minimum_required(VERSION 3.13.1)

set(DTC_OVERLAY_FILE ${CMAKE_CURRENT_SOURCE_DIR}/dts/stm32.overlay.dts)

include($ENV{ZEPHYR_BASE}/cmake/app/boilerplate.cmake NO_POLICY_SCOPE)
project(hello_world)

file(
    GLOB SOURCE_LIST
    src/main.c
    init/pinmux.c
    tests/kernel/sleep/test.c
    tests/kernel/sleep/usleep.c
)

target_sources(app PRIVATE ${SOURCE_LIST})
```

## prj.conf
```kconfig
# nothing here

CONFIG_IRQ_OFFLOAD=y
CONFIG_UART_3=y
CONFIG_DEBUG=y
CONFIG_SHELL=y
```

## dts/stm32.overlay.dts
```dts
/ {
	chosen {
		zephyr,console = &usart3;
		zephyr,shell-uart = &usart3;
	};
};

&usart3 {
	current-speed = <115200>;
	pinctrl-names = "default";
	status = "ok";
};
```

## src/main.c
```c
/*
 * Copyright (c) 2012-2014 Wind River Systems, Inc.
 *
 * SPDX-License-Identifier: Apache-2.0
 */

#include <zephyr.h>
#include <misc/printk.h>

extern void test_sleep(void);

void main(void)
{
	printk("Hello World! %s\n", CONFIG_BOARD);

	test_sleep();
}
```
